## Documentation/devicetree/bindings/display/bridge/anx6345.txt
```
Analogix ANX6345 eDP Transmitter
--------------------------------

The ANX6345 is an ultra-low power Full-HD eDP transmitter designed for
portable devices.

Required properties:

 - compatible		: "analogix,anx6345"
 - reg			: I2C address of the device
 - reset-gpios		: Which GPIO to use for reset

Optional properties:

 - dvdd12-supply	: Regulator for 1.2V digital core power.
 - dvdd25-supply	: Regulator for 2.5V digital core power.
 - Video ports for RGB input and eDP output using the DT bindings
   defined in [1]

[1]: Documentation/devicetree/bindings/media/video-interfaces.txt

Example:

anx6345: anx6345@38 {
	compatible = "analogix,anx6345";
	reg = <0x38>;
	reset-gpios = <&pio 3 24 GPIO_ACTIVE_HIGH>; /* PD24 */
	dvdd25-supply = <&reg_dldo2>;
	dvdd12-supply = <&reg_fldo1>;

	ports {
		#address-cells = <1>;
		#size-cells = <0>;

		anx6345_in: port@0 {
			#address-cells = <1>;
			#size-cells = <0>;
			reg = <0>;
			anx6345_in_tcon0: endpoint@0 {
				reg = <0>;
				remote-endpoint = <&tcon0_out_anx6345>;
			};
		};

		anx6345_out: port@1 {
			#address-cells = <1>;
			#size-cells = <0>;
			reg = <1>;

			anx6345_out_panel: endpoint@0 {
				reg = <0>;
				remote-endpoint = <&panel_in_edp>;
			};
		};
	};
};
```

## Documentation/devicetree/bindings/display/panel/boe,hb140wx1-501.txt
```
BOE HB140WX1-501 14" WXGA (1366x768) TFT LCD panel

Required properties:
- compatible: should be "boe,hb140wx1-501"

This binding is compatible with the edp-connector binding, which is specified
in edp-connector.txt in this display/connectors directory.
```

## Documentation/devicetree/bindings/display/panel/neweast,wjfh116008a.txt
```
NewEast Optoelectronics CO., LTD WJFH116008A 11.6" 1920x1080 TFT LCD panel

Required properties:
- compatible: should be "neweast,wjfh116008a"

This binding is compatible with the edp-connector binding, which is specified
in edp-connector.txt in this display/connector directory.
```
